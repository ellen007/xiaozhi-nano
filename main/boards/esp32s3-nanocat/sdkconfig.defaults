## main/boards/esp32s3-nanocat/sdkconfig.defaults
```kconfig
CONFIG_BOARD_TYPE_ESP32S3_NANOCAT=y
CONFIG_AUTO_FIRMWARE_UPGRADE=n
CONFIG_LANGUAGE_ZH_CN=y
CONFIG_ESPTOOLPY_FLASHSIZE_16MB=y
CONFIG_SPIRAM=y
CONFIG_SPIRAM_MODE_OCT=y
CONFIG_SPIRAM_SPEED_80M=y
```
